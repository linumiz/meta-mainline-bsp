## conf/layer.conf
```bitbake
# We have a conf and classes directory, append to BBPATH
BBPATH .= ":${LAYERDIR}"

# We have a recipes directory, add to BBFILES
BBFILES += "${LAYERDIR}/recipes*/*/*.bb ${LAYERDIR}/recipes*/*/*.bbappend"

BBFILE_COLLECTIONS += "linumiz-bsp"
BBFILE_PATTERN_linumiz-bsp := "^${LAYERDIR}/"
BBFILE_PRIORITY_linumiz-bsp = "10"

LICENSE_PATH += "${LAYERDIR}/licenses"

# Layer dependencies
LAYERSERIES_COMPAT_linumiz-bsp = "zeus dunfell gatesgarth master"
```

## meta-nxp/conf/machine/mys-6ulx-sbc.conf
```bitbake
#@TYPE: Machine
#@NAME: MYS-6ULX Single Board Computer
#@HOMEPAGE: http://www.myirtech.com/list.asp?id=561
#@DESCRIPTION: The MYS-6ULX Single Board Computer is 14x14 form factor from
#		MYiR Tech with imx6ULL SoC + NAND/eMMC
#@BSP: MYS-6ULX Single Board Computer
#@MAINTAINER: Parthiban Nallthambi <parthiban@linumiz.com>

include conf/machine/include/arm/armv7a/tune-cortexa7.inc

UBOOT_NAME = "u-boot"
UBOOT_ENTRYPOINT = "0x87800000"
UBOOT_MAKE_TARGET = ""
UBOOT_SUFFIX = "img"
SPL_BINARY = "SPL"
UBOOT_BINARY = "${UBOOT_NAME}.${UBOOT_SUFFIX}"
UBOOT_MACHINE = "myir_mys_6ulx_defconfig"

PREFERRED_PROVIDER_virtual/bootloader = "u-boot"
PREFERRED_PROVIDER_u-boot = "u-boot"

FITLOADADDR ?= "0x82000000"

PREFERRED_PROVIDER_virtual/kernel ?= "linux-mainline"
PREFERRED_VERSION_linux-mainline ?= "git"
KERNEL_DEVICETREE = "nxp/imx/imx6ull-myir-mys-6ulx-eval.dtb"

KERNEL_CLASSES += "kernel-fitimage"
KERNEL_IMAGETYPE = "fitImage"

RDEPENDS_kernel-base = ""

SERIAL_CONSOLES="115200;ttymxc0"

IMAGE_BOOT_FILES = "fitImage-${MACHINE}.bin;fitImage"

EXTRA_IMAGEDEPENDS += "u-boot"
WKS_FILE_DEPENDS_BOOTLOADERS ?= "u-boot"
IMAGE_FSTYPES = "ext4 ext4.xz tar.bz2 ubifs"
MKUBIFS_ARGS = "-F -m 2048 -e 126976 -c 7943"
```

## wic/sd.wks
```
part SPL    --no-table --align 1  --source rawcopy --sourceparams="file=SPL"
part u-boot --no-table --align 69 --source rawcopy --sourceparams="file=u-boot.img"
part kernel0 --source bootimg-partition --ondisk mmcblk1 --fstype=vfat --label kernel0 --active --size 32M
part root0 --fixed-size 256M  --align 4096 --fstype=squashfs --source rawcopy --sourceparams="file=mys-image-base-mys-6ulx-sbc.ext4"

bootloader --ptable msdos
```
